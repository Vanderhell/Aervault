## examples/esp32s3_crypto/main/Kconfig.projbuild
```kconfig
menu "Aervault crypto footprint selection"
config AV_FOOTPRINT_AUTH
    bool "Include auth adapter"
    default n
config AV_FOOTPRINT_SEAL
    bool "Include seal adapter and counter"
    default n
config AV_FOOTPRINT_PAIR
    bool "Include pair adapter"
    default n
endmenu
```

## examples/esp32s3_nvs/main/Kconfig.projbuild
```kconfig
menu "Aervault hardware campaign"
config AV_FOOTPRINT_SEAL
    bool "Enable AES-GCM for seal campaign"
    default y
endmenu
```
